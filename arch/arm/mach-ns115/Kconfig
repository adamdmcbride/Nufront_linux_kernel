## arch/arm/mach-ns115/Kconfig
```kconfig
menu "Nufront NS115"
	depends on ARCH_NS115

config MACH_NS115_PAD_TEST
	bool "Nufront NS115 Pad Test Board"
	select ARM_GIC
	select PL330
	select HAVE_PATA_PLATFORM
	select NUSMART_PL330_DMA
	select ARCH_SPARSEMEM_ENABLE if CPU_V7 && \
		!NS115_HIGH_PHYS_OFFSET && MMU
	select ZONE_DMA if SPARSEMEM
	help
	  Include support for the Nufront NS115 Pad Test Board.

config MACH_NS115_PAD_REF
	bool "Nufront NS115 Pad Ref Board"
	select ARM_GIC
	select PL330
	select HAVE_PATA_PLATFORM
	select ARCH_SPARSEMEM_ENABLE if CPU_V7 && \
		!NS115_HIGH_PHYS_OFFSET && MMU
	select ZONE_DMA if SPARSEMEM
	help
	  Include support for the Nufront NS115 Pad Ref Board.

config MACH_NS115_PHONE_TEST
	bool "Nufront NS115 Phone Test Board"
	select ARM_GIC
	select HAVE_PATA_PLATFORM
	select ARCH_SPARSEMEM_ENABLE if CPU_V7 && \
		!NS115_HIGH_PHYS_OFFSET && MMU
	select ZONE_DMA if SPARSEMEM
	help
	  Include support for the Nufront NS115 Phone Test Board.

config MACH_NS115_PHONE_REF
	bool "Nufront NS115 Phone Ref Board"
	select ARM_GIC
	select HAVE_PATA_PLATFORM
	select ARCH_SPARSEMEM_ENABLE if CPU_V7 && \
		!NS115_HIGH_PHYS_OFFSET && MMU
	select ZONE_DMA if SPARSEMEM
	help
	  Include support for the Nufront NS115 Phone Ref Board.

config NS115_HIGH_PHYS_OFFSET
	bool "High physical base address for the NS115 platform"
	depends on MMU 
	default y
	help
	  NS115 board has the RAM available at 0x80000000, 
	  2046MB of which being mirrored at 0x80000000. 

config NUSMART_PL330_DMA
	bool
	select PL330
	help
	  NUSMART DMA API Driver for PL330 DMAC.

choice
	prompt "NS115 chip class"
	depends on ARCH_NS115

config CHIP_NORMAL
	bool "Normal"
	select CLASS_NORMAL
	help
	  Select chip class as normal.

config CHIP_HIGH
	bool "High"
	select CLASS_HIGH
	help
	  Select chip class as high.
endchoice

config CLASS_NORMAL
	bool
config CLASS_HIGH
	bool
config CLASS_ULTRA
	bool

config NUSMART_CTS_BUG2509
	bool "0002509: junit.framework.AssertionFailedError"
	depends on RICOH583_AC_DETECT 
	default y
	help
	 The testcase use posix timer which ID is CLOCK_THREAD_CPUTIME_ID 
	 to calc interval, and add log trace , we can fixed this bug;	
endmenu
```

## arch/arm/mach-ns2816/Kconfig
```kconfig
menu "Nufront NS2816"
	depends on ARCH_NS2816

config MACH_NS2816TB
	bool "Nufront NS2816 Test Board"
	select ARM_GIC
	select HAVE_PATA_PLATFORM
	select ARCH_SPARSEMEM_ENABLE if CPU_V7 && \
		!NS2816_HIGH_PHYS_OFFSET && MMU
	select ZONE_DMA if SPARSEMEM
	help
	  Include support for the Nufront NS2816 Test Board.

config MACH_NS2816_DEV_BOARD 
	bool "Nufront NS2816 DEV board"
	select ARM_GIC
	select HAVE_PATA_PLATFORM
	select ARCH_SPARSEMEM_ENABLE if CPU_V7 && \
		!NS2816_HIGH_PHYS_OFFSET && MMU
	select ZONE_DMA if SPARSEMEM
	help
	  Include support for the Nufront NS2816 Dev Board.

config MACH_NS2816_HUASHAN 
	bool "Nufront NS2816 Huashan Board"
	select ARM_GIC
	select HAVE_PATA_PLATFORM
	select ARCH_SPARSEMEM_ENABLE if CPU_V7 && \
		!NS2816_HIGH_PHYS_OFFSET && MMU
	select ZONE_DMA if SPARSEMEM
	help
	  Include support for the Nufront NS2816 Huashan Board.

config MACH_HUANGSHANS
	bool "Nufront NS2816 Huangshan Board"
	select ARM_GIC
	select HAVE_PATA_PLATFORM
	select PL330
	select ARCH_SPARSEMEM_ENABLE if CPU_V7 && \
		!NS2816_HIGH_PHYS_OFFSET && MMU
	select ZONE_DMA if SPARSEMEM
	help
	  Include support for the Nufront NS2816 Huangshan Board.

config NS2816_HIGH_PHYS_OFFSET
	bool "High physical base address for the NS2816 platform"
	depends on MMU 
	default y
	help
	  NS2816 board has the RAM available at 0x80000000, 
	  2046MB of which being mirrored at 0x80000000. 

config NS2816_DDR_32BIT_SUPPORT
	bool "Support ddr 32bit for the NS2816 platform"
	default n
	help
	  Include support for ns2816 platform 

endmenu
```

## drivers/char/apu/Kconfig
```kconfig
#
# PCMCIA character device configuration
#

menu "ns115 Audio Processor"

config NS115_APU
	tristate "ns115 audio processor"
	help
	  Enable support for audio process hardware acceleration.

	  This driver may be built as a module ( = code which can be
	  inserted in and removed from the running kernel whenever you want).
	  The module will be called apudrvk.  If you want to do that, say M
	  here.
endmenu
```

## sound/soc/nusmart/Kconfig
```kconfig
config SND_NUSMART_SOC
	tristate "SoC Audio for the Nufront ltd. ns2816&ns115 chips"
	depends on ARCH_REALVIEW_PBX && SND_SOC
	select SND_ARM


config SND_NUSMART_SOC_MACH
	tristate "SoC Audio support for nusmart"
	depends on ARCH_NS115
	select SND_ARM
	help
	  Say Y if you want to add support for SoC audio on Nusmart
	  models.
choice 
	prompt "Select CPU DAI"
	depends on SND_NUSMART_SOC_MACH
	default SND_NUSMART_SOC_EVA_I2S

config SND_NUSMART_SOC_I2S
	tristate "Use Synopsys I2S as CPU DAI"
	depends on SND_NUSMART_SOC_MACH
	help 
	  Only applies on Nusmart2816-1

config SND_NUSMART_SOC_EVA_I2S
	tristate "Use Evatronics I2S as CPU DAI"
	depends on SND_NUSMART_SOC_MACH
	help 
	  Only applies on Nusmart2816-2

endchoice

choice 
	prompt "Select CODEC DAI"
	depends on SND_NUSMART_SOC_MACH
	default SND_SOC_ALC5631

config SND_SOC_ALC5631
	tristate "Use RT5631 as CODEC DAI"
	depends on SND_NUSMART_SOC_MACH

config SND_SOC_WM8960
	tristate "Use WM8960 as CODEC DAI"
	depends on SND_NUSMART_SOC_MACH

config SND_NUSMART_HDMI_CH7033
        tristate "HDMI Audio on CH7033B support"
        depends on SND_NUSMART_SOC_MACH

endchoice
```
